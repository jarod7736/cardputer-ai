## firmware-idf-probe/sdkconfig.defaults
```kconfig
CONFIG_IDF_TARGET="esp32s3"
CONFIG_ESP_MAIN_TASK_STACK_SIZE=8192
CONFIG_ESPTOOLPY_FLASHSIZE_8MB=y
CONFIG_MBEDTLS_HARDWARE_SHA=y
CONFIG_LWIP_TCP=y
```

## firmware/sdkconfig.defaults
```kconfig
# Cardputer-AI M1 ESP-IDF defaults
CONFIG_IDF_TARGET="esp32s3"
CONFIG_ESP_MAIN_TASK_STACK_SIZE=8192
CONFIG_ESPTOOLPY_FLASHSIZE_8MB=y

# arduino-esp32 as an IDF component requires FreeRTOS tick at 1 kHz.
CONFIG_FREERTOS_HZ=1000

# Let Arduino's core provide app_main() so our setup()/loop() runs as-is.
CONFIG_AUTOSTART_ARDUINO=y

# We need lwIP raw, mbedTLS bigger numbers for WG handshake math, PPP off.
CONFIG_LWIP_PPP_SUPPORT=n
CONFIG_LWIP_IPV4=y
# IPv6 stays on — Arduino's AsyncUDP references IPv6 types unconditionally.
CONFIG_LWIP_IPV6=y
CONFIG_MBEDTLS_HARDWARE_SHA=y
CONFIG_MBEDTLS_HARDWARE_AES=y

# We have no PSRAM (M0 result). Don't pretend.
CONFIG_SPIRAM=n

# Bring up Wi-Fi STA with sane buffer counts; tuned in M2 if needed.
CONFIG_ESP_WIFI_DYNAMIC_RX_BUFFER_NUM=32
CONFIG_ESP_WIFI_STATIC_TX_BUFFER_NUM=8

# esp_wireguard: allow more than one allowed-IP per peer. The library
# auto-adds the device's own /32 into slot 0; we need slots free to add
# the routed CIDR (0.0.0.0/0 for full-tunnel, or LAN+WG-subnet for split).
CONFIG_WIREGUARD_MAX_SRC_IPS=8
```
